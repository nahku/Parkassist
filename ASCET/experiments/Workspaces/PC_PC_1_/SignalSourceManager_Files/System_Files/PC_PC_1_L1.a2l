ASAP2_VERSION 1 41
/begin PROJECT PC_PC_1_ "Generated by ETAS from Project PC_PC_1_"
/begin HEADER "" VERSION "000" PROJECT_NO ASD /end HEADER
/begin MODULE PC_PC_1_ "Generated by ETAS ASCET7 from Project: PC_PC_1_"
/begin IF_DATA E_TARGET
 /begin SOURCE "Task0" 3 /* period */ 10 QP_BLOB 1 /end SOURCE
 /begin TP_BLOB /* programm id */ 3506470290 /* target id */ 7 0 2 0 /end TP_BLOB
/end IF_DATA
/begin MOD_PAR "" VERSION "000" ADDR_EPK 0x0 EPK "" SUPPLIER "ETAS GmbH" CUSTOMER "xxx" CUSTOMER_NO "000" USER "xxx" PHONE_NO "000" ECU "PC" CPU_TYPE "PCx86" NO_OF_INTERFACES 1 /end MOD_PAR
/begin MOD_COMMON "Common definitions" BYTE_ORDER MSB_LAST ALIGNMENT_BYTE 1 ALIGNMENT_WORD 2 ALIGNMENT_LONG 4 ALIGNMENT_FLOAT32_IEEE 4 ALIGNMENT_FLOAT64_IEEE 8 /end MOD_COMMON
/begin CHARACTERISTIC car.FrequencyComputation.FrequencyComputationClass_instance_3.frequency_lookup "" CURVE 0x434000 STANDARD_CURVE_R32R32 0.0 esdl_ident -3.4028234663852886E+38 3.4028234663852886E+38
 /begin AXIS_DESCR STD_AXIS NO_INPUT_QUANTITY esdl_ident 2 -3.4028234663852886E+38 3.4028234663852886E+38 /end AXIS_DESCR
/end CHARACTERISTIC
/begin CHARACTERISTIC car.ParkAssistController.ParkAssistControllerClass_instance_3.curve_cont_table "" CURVE 0x434020 STANDARD_CURVE_R32R32 0.0 esdl_ident -3.4028234663852886E+38 3.4028234663852886E+38
 /begin AXIS_DESCR STD_AXIS NO_INPUT_QUANTITY esdl_ident 6 -3.4028234663852886E+38 3.4028234663852886E+38 /end AXIS_DESCR
/end CHARACTERISTIC
/begin CHARACTERISTIC car.ParkAssistController.ParkAssistControllerClass_instance_4.curve_cont_table "" CURVE 0x434054 STANDARD_CURVE_R32R32 0.0 esdl_ident -3.4028234663852886E+38 3.4028234663852886E+38
 /begin AXIS_DESCR STD_AXIS NO_INPUT_QUANTITY esdl_ident 6 -3.4028234663852886E+38 3.4028234663852886E+38 /end AXIS_DESCR
/end CHARACTERISTIC
/begin MEASUREMENT car.car.driveModel_instance_3.v "" FLOAT32_IEEE esdl_ident 1 100.0 -3.4028234663852886E+38 3.4028234663852886E+38 ECU_ADDRESS 0x45202C /end MEASUREMENT
/begin MEASUREMENT car.car.driveModel_instance_3.s "" FLOAT32_IEEE esdl_ident 1 100.0 -3.4028234663852886E+38 3.4028234663852886E+38 ECU_ADDRESS 0x452024 /end MEASUREMENT
/begin MEASUREMENT car.car.driveModel_instance_3.acc "" FLOAT32_IEEE esdl_ident 1 100.0 -3.4028234663852886E+38 3.4028234663852886E+38 ECU_ADDRESS 0x452020 /end MEASUREMENT
/begin MEASUREMENT car.car.driveModel_instance_3.ultrasonic_distance "" FLOAT32_IEEE esdl_ident 1 100.0 -3.4028234663852886E+38 3.4028234663852886E+38 ECU_ADDRESS 0x452028 /end MEASUREMENT
/begin MEASUREMENT resources.DriverMessages.brake "" FLOAT32_IEEE esdl_ident 1 100.0 -3.4028234663852886E+38 3.4028234663852886E+38 ECU_ADDRESS 0x45205C /end MEASUREMENT
/begin MEASUREMENT resources.CarMessages.v "" FLOAT32_IEEE esdl_ident 1 100.0 -3.4028234663852886E+38 3.4028234663852886E+38 ECU_ADDRESS 0x452048 /end MEASUREMENT
/begin MEASUREMENT resources.CarMessages.acceleration "" FLOAT32_IEEE esdl_ident 1 100.0 -3.4028234663852886E+38 3.4028234663852886E+38 ECU_ADDRESS 0x452058 /end MEASUREMENT
/begin MEASUREMENT resources.CarMessages.position "" FLOAT32_IEEE esdl_ident 1 100.0 -3.4028234663852886E+38 3.4028234663852886E+38 ECU_ADDRESS 0x452054 /end MEASUREMENT
/begin MEASUREMENT resources.CarMessages.ultrasonic_distance "" FLOAT32_IEEE esdl_ident 1 100.0 -3.4028234663852886E+38 3.4028234663852886E+38 ECU_ADDRESS 0x45204C /end MEASUREMENT
/begin MEASUREMENT resources.CarMessages.pulse_signal "" FLOAT32_IEEE esdl_ident 1 100.0 -3.4028234663852886E+38 3.4028234663852886E+38 ECU_ADDRESS 0x452050 /end MEASUREMENT
/begin MEASUREMENT car.FrequencyComputation.PulseSignalClass_instance_2.integrated_frequency "" FLOAT32_IEEE esdl_ident 1 100.0 -3.4028234663852886E+38 3.4028234663852886E+38 ECU_ADDRESS 0x452034 /end MEASUREMENT
/begin MEASUREMENT car.FrequencyComputation.PulseSignalClass_instance_3.integrated_frequency "" FLOAT32_IEEE esdl_ident 1 100.0 -3.4028234663852886E+38 3.4028234663852886E+38 ECU_ADDRESS 0x452038 /end MEASUREMENT
/begin MEASUREMENT car.FrequencyComputation.PulseSignalClass_instance.integrated_frequency "" FLOAT32_IEEE esdl_ident 1 100.0 -3.4028234663852886E+38 3.4028234663852886E+38 ECU_ADDRESS 0x452030 /end MEASUREMENT
/begin MEASUREMENT car.ParkAssistController.settingsExperimentEnvironment_instance.time "" FLOAT32_IEEE esdl_ident 1 100.0 -3.4028234663852886E+38 3.4028234663852886E+38 ECU_ADDRESS 0x45203C /end MEASUREMENT
/begin MEASUREMENT car.ParkAssistController.settingsExperimentEnvironment_instance.StopWatch_instance.time "" FLOAT32_IEEE esdl_ident 1 100.0 -3.4028234663852886E+38 3.4028234663852886E+38 ECU_ADDRESS 0x452040 /end MEASUREMENT
/begin COMPU_METHOD esdl_ident "" RAT_FUNC /* format */ "%12.4" /* unit */ "" /* coeffs */ COEFFS 0 1 0 0 0 1 /end COMPU_METHOD
/begin FUNCTION PC_PC_1_ ""
 /begin SUB_FUNCTION resources.TimeTick car.car car.FrequencyComputation car.ParkAssistController /end SUB_FUNCTION
/end FUNCTION
/begin FUNCTION resources.TimeTick "" /end FUNCTION
/begin FUNCTION car.car "" /begin IN_MEASUREMENT resources.DriverMessages.brake /end IN_MEASUREMENT
 /begin OUT_MEASUREMENT resources.CarMessages.acceleration resources.CarMessages.position resources.CarMessages.ultrasonic_distance resources.CarMessages.v /end OUT_MEASUREMENT
 /begin SUB_FUNCTION car.car.driveModel_instance_3 /end SUB_FUNCTION
/end FUNCTION
/begin FUNCTION car.car.driveModel_instance_3 ""
 /begin LOC_MEASUREMENT car.car.driveModel_instance_3.acc car.car.driveModel_instance_3.s car.car.driveModel_instance_3.ultrasonic_distance car.car.driveModel_instance_3.v /end LOC_MEASUREMENT
/end FUNCTION
/begin FUNCTION car.FrequencyComputation "" /begin IN_MEASUREMENT resources.CarMessages.position resources.CarMessages.v /end IN_MEASUREMENT /begin OUT_MEASUREMENT resources.CarMessages.pulse_signal /end OUT_MEASUREMENT
 /begin SUB_FUNCTION car.FrequencyComputation.PulseSignalClass_instance_2 car.FrequencyComputation.FrequencyComputationClass_instance_3 car.FrequencyComputation.PulseSignalClass_instance_3 car.FrequencyComputation.PulseSignalClass_instance /end SUB_FUNCTION
/end FUNCTION
/begin FUNCTION car.FrequencyComputation.PulseSignalClass_instance_2 ""
 /begin LOC_MEASUREMENT car.FrequencyComputation.PulseSignalClass_instance_2.integrated_frequency /end LOC_MEASUREMENT
/end FUNCTION
/begin FUNCTION car.FrequencyComputation.FrequencyComputationClass_instance_3 ""
 /begin DEF_CHARACTERISTIC car.FrequencyComputation.FrequencyComputationClass_instance_3.frequency_lookup /end DEF_CHARACTERISTIC
/end FUNCTION
/begin FUNCTION car.FrequencyComputation.PulseSignalClass_instance_3 ""
 /begin LOC_MEASUREMENT car.FrequencyComputation.PulseSignalClass_instance_3.integrated_frequency /end LOC_MEASUREMENT
/end FUNCTION
/begin FUNCTION car.FrequencyComputation.PulseSignalClass_instance ""
 /begin LOC_MEASUREMENT car.FrequencyComputation.PulseSignalClass_instance.integrated_frequency /end LOC_MEASUREMENT
/end FUNCTION
/begin FUNCTION car.ParkAssistController "" /begin IN_MEASUREMENT resources.CarMessages.ultrasonic_distance /end IN_MEASUREMENT /begin OUT_MEASUREMENT resources.DriverMessages.brake /end OUT_MEASUREMENT
 /begin SUB_FUNCTION car.ParkAssistController.settingsExperimentEnvironment_instance car.ParkAssistController.ParkAssistControllerClass_instance_3 car.ParkAssistController.ParkAssistControllerClass_instance_4 /end SUB_FUNCTION
/end FUNCTION
/begin FUNCTION car.ParkAssistController.settingsExperimentEnvironment_instance ""
 /begin LOC_MEASUREMENT car.ParkAssistController.settingsExperimentEnvironment_instance.time /end LOC_MEASUREMENT
 /begin SUB_FUNCTION car.ParkAssistController.settingsExperimentEnvironment_instance.StopWatch_instance /end SUB_FUNCTION
/end FUNCTION
/begin FUNCTION car.ParkAssistController.settingsExperimentEnvironment_instance.StopWatch_instance ""
 /begin LOC_MEASUREMENT car.ParkAssistController.settingsExperimentEnvironment_instance.StopWatch_instance.time /end LOC_MEASUREMENT
/end FUNCTION
/begin FUNCTION car.ParkAssistController.ParkAssistControllerClass_instance_3 ""
 /begin DEF_CHARACTERISTIC car.ParkAssistController.ParkAssistControllerClass_instance_3.curve_cont_table /end DEF_CHARACTERISTIC
/end FUNCTION
/begin FUNCTION car.ParkAssistController.ParkAssistControllerClass_instance_4 ""
 /begin DEF_CHARACTERISTIC car.ParkAssistController.ParkAssistControllerClass_instance_4.curve_cont_table /end DEF_CHARACTERISTIC
/end FUNCTION
/begin RECORD_LAYOUT STANDARD_CURVE_R32R32 /* axis size */ NO_AXIS_PTS_X 1 UWORD /* axis */ AXIS_PTS_X 2 FLOAT32_IEEE INDEX_INCR DIRECT /* value */ FNC_VALUES 3 FLOAT32_IEEE COLUMN_DIR DIRECT /end RECORD_LAYOUT
/begin GROUP PC_PC_1_ "" ROOT
 /begin SUB_GROUP resources.TimeTick car.car resources.DriverMessages resources.CarMessages car.FrequencyComputation car.ParkAssistController /end SUB_GROUP
/end GROUP
/begin GROUP resources.TimeTick "" /end GROUP
/begin GROUP car.car "" /begin SUB_GROUP car.car.driveModel_instance_3 /end SUB_GROUP /end GROUP
/begin GROUP car.car.driveModel_instance_3 ""
 /begin REF_MEASUREMENT car.car.driveModel_instance_3.acc car.car.driveModel_instance_3.s car.car.driveModel_instance_3.ultrasonic_distance car.car.driveModel_instance_3.v /end REF_MEASUREMENT
/end GROUP
/begin GROUP resources.DriverMessages "" /begin REF_MEASUREMENT resources.DriverMessages.brake /end REF_MEASUREMENT /end GROUP
/begin GROUP resources.CarMessages ""
 /begin REF_MEASUREMENT resources.CarMessages.acceleration resources.CarMessages.position resources.CarMessages.pulse_signal resources.CarMessages.ultrasonic_distance resources.CarMessages.v /end REF_MEASUREMENT
/end GROUP
/begin GROUP car.FrequencyComputation ""
 /begin SUB_GROUP car.FrequencyComputation.PulseSignalClass_instance_2 car.FrequencyComputation.FrequencyComputationClass_instance_3 car.FrequencyComputation.PulseSignalClass_instance_3 car.FrequencyComputation.PulseSignalClass_instance /end SUB_GROUP
/end GROUP
/begin GROUP car.FrequencyComputation.PulseSignalClass_instance_2 ""
 /begin REF_MEASUREMENT car.FrequencyComputation.PulseSignalClass_instance_2.integrated_frequency /end REF_MEASUREMENT
/end GROUP
/begin GROUP car.FrequencyComputation.FrequencyComputationClass_instance_3 ""
 /begin REF_CHARACTERISTIC car.FrequencyComputation.FrequencyComputationClass_instance_3.frequency_lookup /end REF_CHARACTERISTIC
/end GROUP
/begin GROUP car.FrequencyComputation.PulseSignalClass_instance_3 ""
 /begin REF_MEASUREMENT car.FrequencyComputation.PulseSignalClass_instance_3.integrated_frequency /end REF_MEASUREMENT
/end GROUP
/begin GROUP car.FrequencyComputation.PulseSignalClass_instance ""
 /begin REF_MEASUREMENT car.FrequencyComputation.PulseSignalClass_instance.integrated_frequency /end REF_MEASUREMENT
/end GROUP
/begin GROUP car.ParkAssistController ""
 /begin SUB_GROUP car.ParkAssistController.settingsExperimentEnvironment_instance car.ParkAssistController.ParkAssistControllerClass_instance_3 car.ParkAssistController.ParkAssistControllerClass_instance_4 /end SUB_GROUP
/end GROUP
/begin GROUP car.ParkAssistController.settingsExperimentEnvironment_instance ""
 /begin REF_MEASUREMENT car.ParkAssistController.settingsExperimentEnvironment_instance.time /end REF_MEASUREMENT
 /begin SUB_GROUP car.ParkAssistController.settingsExperimentEnvironment_instance.StopWatch_instance /end SUB_GROUP
/end GROUP
/begin GROUP car.ParkAssistController.settingsExperimentEnvironment_instance.StopWatch_instance ""
 /begin REF_MEASUREMENT car.ParkAssistController.settingsExperimentEnvironment_instance.StopWatch_instance.time /end REF_MEASUREMENT
/end GROUP
/begin GROUP car.ParkAssistController.ParkAssistControllerClass_instance_3 ""
 /begin REF_CHARACTERISTIC car.ParkAssistController.ParkAssistControllerClass_instance_3.curve_cont_table /end REF_CHARACTERISTIC
/end GROUP
/begin GROUP car.ParkAssistController.ParkAssistControllerClass_instance_4 ""
 /begin REF_CHARACTERISTIC car.ParkAssistController.ParkAssistControllerClass_instance_4.curve_cont_table /end REF_CHARACTERISTIC
/end GROUP
/end MODULE
/end PROJECT
