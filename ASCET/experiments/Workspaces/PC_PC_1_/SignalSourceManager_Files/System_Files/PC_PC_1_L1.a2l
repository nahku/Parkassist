ASAP2_VERSION 1 41
/begin PROJECT PC_PC_1_ "Generated by ETAS from Project PC_PC_1_"
/begin HEADER "" VERSION "000" PROJECT_NO ASD /end HEADER
/begin MODULE PC_PC_1_ "Generated by ETAS ASCET7 from Project: PC_PC_1_"
/begin IF_DATA E_TARGET
 /begin SOURCE "Task0" /* type */ 3 /* period */ 10 QP_BLOB 1 /end SOURCE
 /begin TP_BLOB /* programm id */ 3003124996 /* target id */ 7 0 2 0 /end TP_BLOB
/end IF_DATA
/begin MOD_PAR "" VERSION "000" ADDR_EPK 0x0 EPK "" SUPPLIER "ETAS GmbH" CUSTOMER "xxx" CUSTOMER_NO "000" USER "xxx" PHONE_NO "000" ECU "PC" CPU_TYPE "PCx86" NO_OF_INTERFACES 1 /end MOD_PAR
/begin MOD_COMMON "Common definitions" BYTE_ORDER MSB_LAST ALIGNMENT_BYTE 1 ALIGNMENT_WORD 2 ALIGNMENT_LONG 4 ALIGNMENT_FLOAT32_IEEE 4 ALIGNMENT_FLOAT64_IEEE 8 /end MOD_COMMON
/begin MEASUREMENT car.car.c "" FLOAT32_IEEE esdl_ident 1 100.0 -3.4028234663852886E+38 3.4028234663852886E+38 ECU_ADDRESS 0x451084 /end MEASUREMENT
/begin MEASUREMENT car.car.b "" FLOAT32_IEEE esdl_ident 1 100.0 -3.4028234663852886E+38 3.4028234663852886E+38 ECU_ADDRESS 0x451080 /end MEASUREMENT
/begin MEASUREMENT car.car.v "" FLOAT32_IEEE esdl_ident 1 100.0 -3.4028234663852886E+38 3.4028234663852886E+38 ECU_ADDRESS 0x451088 /end MEASUREMENT
/begin MEASUREMENT car.car.driveModel_instance_7.v "" FLOAT32_IEEE esdl_ident 1 100.0 -3.4028234663852886E+38 3.4028234663852886E+38 ECU_ADDRESS 0x451098 /end MEASUREMENT
/begin MEASUREMENT car.car.driveModel_instance_7.p "" FLOAT32_IEEE esdl_ident 1 100.0 -3.4028234663852886E+38 3.4028234663852886E+38 ECU_ADDRESS 0x451090 /end MEASUREMENT
/begin MEASUREMENT car.car.driveModel_instance_7.s "" FLOAT32_IEEE esdl_ident 1 100.0 -3.4028234663852886E+38 3.4028234663852886E+38 ECU_ADDRESS 0x451094 /end MEASUREMENT
/begin MEASUREMENT car.car.driveModel_instance_7.v_2 "" FLOAT32_IEEE esdl_ident 1 100.0 -3.4028234663852886E+38 3.4028234663852886E+38 ECU_ADDRESS 0x45109C /end MEASUREMENT
/begin MEASUREMENT car.car.driveModel_instance_7.acc "" FLOAT32_IEEE esdl_ident 1 100.0 -3.4028234663852886E+38 3.4028234663852886E+38 ECU_ADDRESS 0x45108C /end MEASUREMENT
/begin MEASUREMENT car.car.driveModel_instance_8.v "" FLOAT32_IEEE esdl_ident 1 100.0 -3.4028234663852886E+38 3.4028234663852886E+38 ECU_ADDRESS 0x4510AC /end MEASUREMENT
/begin MEASUREMENT car.car.driveModel_instance_8.p "" FLOAT32_IEEE esdl_ident 1 100.0 -3.4028234663852886E+38 3.4028234663852886E+38 ECU_ADDRESS 0x4510A4 /end MEASUREMENT
/begin MEASUREMENT car.car.driveModel_instance_8.s "" FLOAT32_IEEE esdl_ident 1 100.0 -3.4028234663852886E+38 3.4028234663852886E+38 ECU_ADDRESS 0x4510A8 /end MEASUREMENT
/begin MEASUREMENT car.car.driveModel_instance_8.v_2 "" FLOAT32_IEEE esdl_ident 1 100.0 -3.4028234663852886E+38 3.4028234663852886E+38 ECU_ADDRESS 0x4510B0 /end MEASUREMENT
/begin MEASUREMENT car.car.driveModel_instance_8.acc "" FLOAT32_IEEE esdl_ident 1 100.0 -3.4028234663852886E+38 3.4028234663852886E+38 ECU_ADDRESS 0x4510A0 /end MEASUREMENT
/begin MEASUREMENT resources.DriverMessages.brake "" FLOAT32_IEEE esdl_ident 1 100.0 -3.4028234663852886E+38 3.4028234663852886E+38 ECU_ADDRESS 0x4340DC /end MEASUREMENT
/begin MEASUREMENT resources.CarMessages.v "" FLOAT32_IEEE esdl_ident 1 100.0 -3.4028234663852886E+38 3.4028234663852886E+38 ECU_ADDRESS 0x4340D4 /end MEASUREMENT
/begin MEASUREMENT resources.CarMessages.acceleration "" FLOAT32_IEEE esdl_ident 1 100.0 -3.4028234663852886E+38 3.4028234663852886E+38 ECU_ADDRESS 0x4510C8 /end MEASUREMENT
/begin MEASUREMENT resources.CarMessages.position "" FLOAT32_IEEE esdl_ident 1 100.0 -3.4028234663852886E+38 3.4028234663852886E+38 ECU_ADDRESS 0x4510C4 /end MEASUREMENT
/begin MEASUREMENT resources.CarMessages.ultrasonic_distance "" FLOAT32_IEEE esdl_ident 1 100.0 -3.4028234663852886E+38 3.4028234663852886E+38 ECU_ADDRESS 0x4340D8 /end MEASUREMENT
/begin COMPU_METHOD esdl_ident "" /* type */ RAT_FUNC /* format */ "%12.4" /* unit */ "" /* coeffs */ COEFFS 0 1 0 0 0 1 /end COMPU_METHOD
/begin FUNCTION PC_PC_1_ "" /begin SUB_FUNCTION resources.TimeTick car.car /end SUB_FUNCTION /end FUNCTION
/begin FUNCTION resources.TimeTick "" /end FUNCTION
/begin FUNCTION car.car "" /begin IN_MEASUREMENT resources.DriverMessages.brake /end IN_MEASUREMENT
 /begin OUT_MEASUREMENT resources.CarMessages.acceleration resources.CarMessages.position resources.CarMessages.v /end OUT_MEASUREMENT
 /begin LOC_MEASUREMENT car.car.b car.car.c car.car.v /end LOC_MEASUREMENT
 /begin SUB_FUNCTION car.car.driveModel_instance_7 car.car.driveModel_instance_8 /end SUB_FUNCTION
/end FUNCTION
/begin FUNCTION car.car.driveModel_instance_7 ""
 /begin LOC_MEASUREMENT car.car.driveModel_instance_7.acc car.car.driveModel_instance_7.p car.car.driveModel_instance_7.s car.car.driveModel_instance_7.v car.car.driveModel_instance_7.v_2 /end LOC_MEASUREMENT
/end FUNCTION
/begin FUNCTION car.car.driveModel_instance_8 ""
 /begin LOC_MEASUREMENT car.car.driveModel_instance_8.acc car.car.driveModel_instance_8.p car.car.driveModel_instance_8.s car.car.driveModel_instance_8.v car.car.driveModel_instance_8.v_2 /end LOC_MEASUREMENT
/end FUNCTION
/begin GROUP PC_PC_1_ "" ROOT
 /begin SUB_GROUP resources.TimeTick car.car resources.DriverMessages resources.CarMessages /end SUB_GROUP
/end GROUP
/begin GROUP resources.TimeTick "" /end GROUP
/begin GROUP car.car "" /begin REF_MEASUREMENT car.car.b car.car.c car.car.v /end REF_MEASUREMENT
 /begin SUB_GROUP car.car.driveModel_instance_7 car.car.driveModel_instance_8 /end SUB_GROUP
/end GROUP
/begin GROUP car.car.driveModel_instance_7 ""
 /begin REF_MEASUREMENT car.car.driveModel_instance_7.acc car.car.driveModel_instance_7.p car.car.driveModel_instance_7.s car.car.driveModel_instance_7.v car.car.driveModel_instance_7.v_2 /end REF_MEASUREMENT
/end GROUP
/begin GROUP car.car.driveModel_instance_8 ""
 /begin REF_MEASUREMENT car.car.driveModel_instance_8.acc car.car.driveModel_instance_8.p car.car.driveModel_instance_8.s car.car.driveModel_instance_8.v car.car.driveModel_instance_8.v_2 /end REF_MEASUREMENT
/end GROUP
/begin GROUP resources.DriverMessages "" /begin REF_MEASUREMENT resources.DriverMessages.brake /end REF_MEASUREMENT /end GROUP
/begin GROUP resources.CarMessages ""
 /begin REF_MEASUREMENT resources.CarMessages.acceleration resources.CarMessages.position resources.CarMessages.ultrasonic_distance resources.CarMessages.v /end REF_MEASUREMENT
/end GROUP
/end MODULE
/end PROJECT
