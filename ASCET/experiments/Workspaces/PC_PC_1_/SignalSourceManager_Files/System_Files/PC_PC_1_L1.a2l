ASAP2_VERSION 1 41
/begin PROJECT PC_PC_1_ "Generated by ETAS from Project PC_PC_1_"
/begin HEADER "" VERSION "000" PROJECT_NO ASD /end HEADER
/begin MODULE PC_PC_1_ "Generated by ETAS ASCET7 from Project: PC_PC_1_"
/begin IF_DATA E_TARGET
 /begin SOURCE "Task1" 3 /* period */ 2 QP_BLOB 1 /end SOURCE
 /begin SOURCE "Task0" 3 /* period */ 10 QP_BLOB 2 /end SOURCE
 /begin TP_BLOB /* programm id */ 4135602472 /* target id */ 7 0 2 0 /end TP_BLOB
/end IF_DATA
/begin MOD_PAR "" VERSION "000" ADDR_EPK 0x0 EPK "" SUPPLIER "ETAS GmbH" CUSTOMER "xxx" CUSTOMER_NO "000" USER "xxx" PHONE_NO "000" ECU "PC" CPU_TYPE "PCx86" NO_OF_INTERFACES 1 /end MOD_PAR
/begin MOD_COMMON "Common definitions" BYTE_ORDER MSB_LAST ALIGNMENT_BYTE 1 ALIGNMENT_WORD 2 ALIGNMENT_LONG 4 ALIGNMENT_FLOAT32_IEEE 4 ALIGNMENT_FLOAT64_IEEE 8 /end MOD_COMMON
/begin CHARACTERISTIC car.FrequencyComputation.FrequencyComputationClass_instance_3.frequency_lookup "" CURVE /* ecu address */ 0x435214 /* record layout */ STANDARD_CURVE_R32R32 /* max diff value */ 0.0 esdl_ident -3.4028234663852886E+38 3.4028234663852886E+38
 /begin AXIS_DESCR /* axis type */ STD_AXIS /* input quantity */ NO_INPUT_QUANTITY esdl_ident /* max axis point */ 2 -3.4028234663852886E+38 3.4028234663852886E+38 /end AXIS_DESCR
/end CHARACTERISTIC
/begin CHARACTERISTIC car.ParkAssistController.ParkAssistControllerClass_instance_4.curve_cont_table "" CURVE /* ecu address */ 0x435240 /* record layout */ STANDARD_CURVE_R32R32 /* max diff value */ 0.0 esdl_ident -3.4028234663852886E+38 3.4028234663852886E+38
 /begin AXIS_DESCR /* axis type */ STD_AXIS /* input quantity */ NO_INPUT_QUANTITY esdl_ident /* max axis point */ 7 -3.4028234663852886E+38 3.4028234663852886E+38 /end AXIS_DESCR
/end CHARACTERISTIC
/begin MEASUREMENT car.car.driveModel_instance_2.v "" FLOAT32_IEEE esdl_ident 1 100.0 -3.4028234663852886E+38 3.4028234663852886E+38 ECU_ADDRESS 0x435210 /end MEASUREMENT
/begin MEASUREMENT car.car.driveModel_instance_2.s "" FLOAT32_IEEE esdl_ident 1 100.0 -3.4028234663852886E+38 3.4028234663852886E+38 ECU_ADDRESS 0x435208 /end MEASUREMENT
/begin MEASUREMENT car.car.driveModel_instance_2.acc "" FLOAT32_IEEE esdl_ident 1 100.0 -3.4028234663852886E+38 3.4028234663852886E+38 ECU_ADDRESS 0x435204 /end MEASUREMENT
/begin MEASUREMENT car.car.driveModel_instance_2.ultrasonic_distance "" FLOAT32_IEEE esdl_ident 1 100.0 -3.4028234663852886E+38 3.4028234663852886E+38 ECU_ADDRESS 0x43520C /end MEASUREMENT
/begin MEASUREMENT resources.ParkAssistMessages.brake "" FLOAT32_IEEE esdl_ident 1 100.0 -3.4028234663852886E+38 3.4028234663852886E+38 ECU_ADDRESS 0x453108 /end MEASUREMENT
/begin MEASUREMENT resources.CarMessages.v "" FLOAT32_IEEE esdl_ident 1 100.0 -3.4028234663852886E+38 3.4028234663852886E+38 ECU_ADDRESS 0x4530F4 /end MEASUREMENT
/begin MEASUREMENT resources.CarMessages.acceleration "" FLOAT32_IEEE esdl_ident 1 100.0 -3.4028234663852886E+38 3.4028234663852886E+38 ECU_ADDRESS 0x453104 /end MEASUREMENT
/begin MEASUREMENT resources.CarMessages.position "" FLOAT32_IEEE esdl_ident 1 100.0 -3.4028234663852886E+38 3.4028234663852886E+38 ECU_ADDRESS 0x453100 /end MEASUREMENT
/begin MEASUREMENT resources.CarMessages.ultrasonic_distance "" FLOAT32_IEEE esdl_ident 1 100.0 -3.4028234663852886E+38 3.4028234663852886E+38 ECU_ADDRESS 0x4530F8 /end MEASUREMENT
/begin MEASUREMENT resources.CarMessages.pulse_signal "" FLOAT32_IEEE esdl_ident 1 100.0 -3.4028234663852886E+38 3.4028234663852886E+38 ECU_ADDRESS 0x4530FC /end MEASUREMENT
/begin MEASUREMENT car.FrequencyComputation.PulseSignalClass_instance.integrated_frequency "" FLOAT32_IEEE esdl_ident 1 100.0 -3.4028234663852886E+38 3.4028234663852886E+38 ECU_ADDRESS 0x4530E8 /end MEASUREMENT
/begin MEASUREMENT car.ParkAssistController.time "" FLOAT32_IEEE esdl_ident 1 100.0 -3.4028234663852886E+38 3.4028234663852886E+38 ECU_ADDRESS 0x4530EC /end MEASUREMENT
/begin MEASUREMENT test.SystemTestBD.SystemTest_instance_3.sm "" UBYTE esdl_test_SystemTestStatemachineStates 1 100.0 0 1 ECU_ADDRESS 0x453118 /end MEASUREMENT
/begin MEASUREMENT test.SystemTestBD.SystemTest_instance_3.v "" FLOAT32_IEEE esdl_ident 1 100.0 -3.4028234663852886E+38 3.4028234663852886E+38 ECU_ADDRESS 0x453114 /end MEASUREMENT
/begin MEASUREMENT test.SystemTestBD.SystemTest_instance_3.pulseSignal "" FLOAT32_IEEE esdl_ident 1 100.0 -3.4028234663852886E+38 3.4028234663852886E+38 ECU_ADDRESS 0x453110 /end MEASUREMENT
/begin MEASUREMENT test.SystemTestBD.SystemTest_instance_3.position "" FLOAT32_IEEE esdl_ident 1 100.0 -3.4028234663852886E+38 3.4028234663852886E+38 ECU_ADDRESS 0x45310C /end MEASUREMENT
/begin MEASUREMENT test.SystemTestBD.SystemTest_instance_3.systemTest "" UBYTE esdl_ident 1 100.0 0 1 ECU_ADDRESS 0x453119 BIT_MASK 0x1 /end MEASUREMENT
/begin MEASUREMENT resources.StateHandlerMessages.systemTest "" UBYTE esdl_ident 1 100.0 0 1 ECU_ADDRESS 0x435280 BIT_MASK 0x1 /end MEASUREMENT
/begin COMPU_METHOD esdl_ident "" RAT_FUNC /* format */ "%12.4" /* unit */ "" /* coeffs */ COEFFS 0 1 0 0 0 1 /end COMPU_METHOD
/begin COMPU_METHOD esdl_test_SystemTestStatemachineStates "" TAB_VERB /* format */ "%12.4" /* unit */ "" /* compu_tab_ref */ COMPU_TAB_REF esdl_test_SystemTestStatemachineStates_vtab /end COMPU_METHOD
/begin COMPU_VTAB esdl_test_SystemTestStatemachineStates_vtab "" TAB_VERB /* number value pairs */ 2 /* value pair */ 0 "Correct" /* value pair */ 1 "Error" /* default value */ DEFAULT_VALUE "Error" /end COMPU_VTAB
/begin FUNCTION PC_PC_1_ ""
 /begin SUB_FUNCTION resources.TimeTick car.car car.FrequencyComputation car.ParkAssistController test.SystemTestBD /end SUB_FUNCTION
/end FUNCTION
/begin FUNCTION resources.TimeTick "" /end FUNCTION
/begin FUNCTION car.car "" /begin IN_MEASUREMENT resources.ParkAssistMessages.brake /end IN_MEASUREMENT
 /begin OUT_MEASUREMENT resources.CarMessages.acceleration resources.CarMessages.position resources.CarMessages.ultrasonic_distance resources.CarMessages.v /end OUT_MEASUREMENT
 /begin SUB_FUNCTION car.car.driveModel_instance_2 /end SUB_FUNCTION
/end FUNCTION
/begin FUNCTION car.car.driveModel_instance_2 ""
 /begin LOC_MEASUREMENT car.car.driveModel_instance_2.acc car.car.driveModel_instance_2.s car.car.driveModel_instance_2.ultrasonic_distance car.car.driveModel_instance_2.v /end LOC_MEASUREMENT
/end FUNCTION
/begin FUNCTION car.FrequencyComputation "" /begin IN_MEASUREMENT resources.CarMessages.position resources.CarMessages.v /end IN_MEASUREMENT /begin OUT_MEASUREMENT resources.CarMessages.pulse_signal /end OUT_MEASUREMENT
 /begin SUB_FUNCTION car.FrequencyComputation.FrequencyComputationClass_instance_3 car.FrequencyComputation.PulseSignalClass_instance /end SUB_FUNCTION
/end FUNCTION
/begin FUNCTION car.FrequencyComputation.FrequencyComputationClass_instance_3 ""
 /begin DEF_CHARACTERISTIC car.FrequencyComputation.FrequencyComputationClass_instance_3.frequency_lookup /end DEF_CHARACTERISTIC
/end FUNCTION
/begin FUNCTION car.FrequencyComputation.PulseSignalClass_instance ""
 /begin LOC_MEASUREMENT car.FrequencyComputation.PulseSignalClass_instance.integrated_frequency /end LOC_MEASUREMENT
/end FUNCTION
/begin FUNCTION car.ParkAssistController "" /begin OUT_MEASUREMENT resources.ParkAssistMessages.brake /end OUT_MEASUREMENT /begin LOC_MEASUREMENT car.ParkAssistController.time /end LOC_MEASUREMENT
 /begin SUB_FUNCTION car.ParkAssistController.ParkAssistControllerClass_instance_4 /end SUB_FUNCTION
/end FUNCTION
/begin FUNCTION car.ParkAssistController.ParkAssistControllerClass_instance_4 ""
 /begin DEF_CHARACTERISTIC car.ParkAssistController.ParkAssistControllerClass_instance_4.curve_cont_table /end DEF_CHARACTERISTIC
/end FUNCTION
/begin FUNCTION test.SystemTestBD ""
 /begin IN_MEASUREMENT resources.CarMessages.position resources.CarMessages.pulse_signal resources.CarMessages.v /end IN_MEASUREMENT
 /begin OUT_MEASUREMENT resources.StateHandlerMessages.systemTest /end OUT_MEASUREMENT
 /begin SUB_FUNCTION test.SystemTestBD.SystemTest_instance_3 /end SUB_FUNCTION
/end FUNCTION
/begin FUNCTION test.SystemTestBD.SystemTest_instance_3 ""
 /begin LOC_MEASUREMENT test.SystemTestBD.SystemTest_instance_3.position test.SystemTestBD.SystemTest_instance_3.pulseSignal test.SystemTestBD.SystemTest_instance_3.sm test.SystemTestBD.SystemTest_instance_3.systemTest test.SystemTestBD.SystemTest_instance_3.v /end LOC_MEASUREMENT
/end FUNCTION
/begin RECORD_LAYOUT STANDARD_CURVE_R32R32 /* axis size */ NO_AXIS_PTS_X 1 UWORD /* axis */ AXIS_PTS_X 2 FLOAT32_IEEE INDEX_INCR DIRECT /* value */ FNC_VALUES 3 FLOAT32_IEEE COLUMN_DIR DIRECT /end RECORD_LAYOUT
/begin GROUP PC_PC_1_ "" ROOT
 /begin SUB_GROUP resources.TimeTick car.car resources.ParkAssistMessages resources.CarMessages car.FrequencyComputation car.ParkAssistController test.SystemTestBD resources.StateHandlerMessages /end SUB_GROUP
/end GROUP
/begin GROUP resources.TimeTick "" /end GROUP
/begin GROUP car.car "" /begin SUB_GROUP car.car.driveModel_instance_2 /end SUB_GROUP /end GROUP
/begin GROUP car.car.driveModel_instance_2 ""
 /begin REF_MEASUREMENT car.car.driveModel_instance_2.acc car.car.driveModel_instance_2.s car.car.driveModel_instance_2.ultrasonic_distance car.car.driveModel_instance_2.v /end REF_MEASUREMENT
/end GROUP
/begin GROUP resources.ParkAssistMessages "" /begin REF_MEASUREMENT resources.ParkAssistMessages.brake /end REF_MEASUREMENT /end GROUP
/begin GROUP resources.CarMessages ""
 /begin REF_MEASUREMENT resources.CarMessages.acceleration resources.CarMessages.position resources.CarMessages.pulse_signal resources.CarMessages.ultrasonic_distance resources.CarMessages.v /end REF_MEASUREMENT
/end GROUP
/begin GROUP car.FrequencyComputation ""
 /begin SUB_GROUP car.FrequencyComputation.FrequencyComputationClass_instance_3 car.FrequencyComputation.PulseSignalClass_instance /end SUB_GROUP
/end GROUP
/begin GROUP car.FrequencyComputation.FrequencyComputationClass_instance_3 ""
 /begin REF_CHARACTERISTIC car.FrequencyComputation.FrequencyComputationClass_instance_3.frequency_lookup /end REF_CHARACTERISTIC
/end GROUP
/begin GROUP car.FrequencyComputation.PulseSignalClass_instance ""
 /begin REF_MEASUREMENT car.FrequencyComputation.PulseSignalClass_instance.integrated_frequency /end REF_MEASUREMENT
/end GROUP
/begin GROUP car.ParkAssistController "" /begin REF_MEASUREMENT car.ParkAssistController.time /end REF_MEASUREMENT
 /begin SUB_GROUP car.ParkAssistController.ParkAssistControllerClass_instance_4 /end SUB_GROUP
/end GROUP
/begin GROUP car.ParkAssistController.ParkAssistControllerClass_instance_4 ""
 /begin REF_CHARACTERISTIC car.ParkAssistController.ParkAssistControllerClass_instance_4.curve_cont_table /end REF_CHARACTERISTIC
/end GROUP
/begin GROUP test.SystemTestBD "" /begin SUB_GROUP test.SystemTestBD.SystemTest_instance_3 /end SUB_GROUP /end GROUP
/begin GROUP test.SystemTestBD.SystemTest_instance_3 ""
 /begin REF_MEASUREMENT test.SystemTestBD.SystemTest_instance_3.position test.SystemTestBD.SystemTest_instance_3.pulseSignal test.SystemTestBD.SystemTest_instance_3.sm test.SystemTestBD.SystemTest_instance_3.systemTest test.SystemTestBD.SystemTest_instance_3.v /end REF_MEASUREMENT
/end GROUP
/begin GROUP resources.StateHandlerMessages "" /begin REF_MEASUREMENT resources.StateHandlerMessages.systemTest /end REF_MEASUREMENT /end GROUP
/end MODULE
/end PROJECT
